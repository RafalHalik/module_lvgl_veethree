## Kconfig
```kconfig
# Copyright (c) 2023 Fabian Blatz <fabianblatz@gmail.com>
# Copyright 2023 NXP
# SPDX-License-Identifier: Apache-2.0

config ZEPHYR_LVGL_MODULE_VEETHREE
	bool

config LVGL_VEETHREE
	bool "LVGL support"
	help
	  This option enables the LVGL graphics library.

if LVGL_VEETHREE

config LV_USE_MONKEY_VEETHREE
	bool

config LV_DPI_DEF_VEETHREE
	int

config LV_CONF_SKIP_VEETHREE
	bool
	default n

config LV_USE_LOG_VEETHREE
	bool

config LV_LOG_LEVEL_NONE_VEETHREE
	bool

config LV_LOG_LEVEL_ERROR_VEETHREE
	bool

config LV_LOG_LEVEL_WARN_VEETHREE
	bool

config LV_LOG_LEVEL_INFO_VEETHREE
	bool

config LV_LOG_LEVEL_USER_VEETHREE
	bool

config LV_LOG_LEVEL_TRACE_VEETHREE
	bool

config LV_Z_LOG_LEVEL_VEETHREE
	int
	default 0 if LV_LOG_LEVEL_NONE_VEETHREE || !LV_USE_LOG_VEETHREE
	default 1 if LV_LOG_LEVEL_ERROR_VEETHREE
	default 2 if LV_LOG_LEVEL_WARN_VEETHREE
	default 3 if LV_LOG_LEVEL_INFO_VEETHREE
	default 3 if LV_LOG_LEVEL_USER_VEETHREE
	default 4 if LV_LOG_LEVEL_TRACE_VEETHREE

config LV_Z_USE_ROUNDER_CB_VEETHREE
	bool
	default y if LV_Z_AREA_X_ALIGNMENT_WIDTH_VEETHREE != 1 || LV_Z_AREA_Y_ALIGNMENT_WIDTH_VEETHREE != 1

config APP_LINK_WITH_LVGL_VEETHREE
	bool "Link 'app' with LVGL"
	default y
	help
	  Add LVGL header files to the 'app' include path. It may be
	  disabled if the include paths for LVGL are causing aliasing
	  issues for 'app'.

config LV_Z_USE_FILESYSTEM_VEETHREE
	bool "LVGL file system support"
	depends on FILE_SYSTEM
	default y if FILE_SYSTEM
	help
	  Enable LittlevGL file system

choice LV_COLOR_DEPTH_VEETHREE
	default LV_COLOR_DEPTH_16_VEETHREE
	prompt "Color depth (bits per pixel)"

	config LV_COLOR_DEPTH_32_VEETHREE
		bool "32: ARGB8888"
	config LV_COLOR_DEPTH_16_VEETHREE
		bool "16: RGB565"
	config LV_COLOR_DEPTH_8_VEETHREE
		bool "8: RGB232"
	config LV_COLOR_DEPTH_1_VEETHREE
		bool "1: monochrome"
endchoice

config LV_COLOR_16_SWAP_VEETHREE
	bool

config LV_Z_FLUSH_THREAD_VEETHREE
	bool "Flush LVGL frames in a separate thread"
	help
	  Flush LVGL frames in a separate thread, while the primary thread
	  renders the next LVGL frame. Can be disabled if the performance
	  gain this approach offers is not required

if LV_Z_FLUSH_THREAD_VEETHREE

config LV_Z_FLUSH_THREAD_STACK_SIZE_VEETHREE
	int "Stack size for flushing thread"
	default 1024
	help
	  Stack size for LVGL flush thread, which will call display_write

config LV_Z_FLUSH_THREAD_PRIO_VEETHREE
	int "LVGL flush thread priority"
	default 0
	help
	  Cooperative priority of LVGL flush thread.

endif # LV_Z_FLUSH_THREAD_VEETHREE

config LV_Z_AREA_X_ALIGNMENT_WIDTH_VEETHREE
	int "Frame X alignment size"
	default 1
	help
	  Number of pixels, X axis should be rounded to. Should be used to override
	  the current frame dimensions to meet display and/or LCD host
	  controller requirements. The value must be power of 2.

config LV_Z_AREA_Y_ALIGNMENT_WIDTH_VEETHREE
	int "Frame Y alignment size"
	default 1
	help
	  Number of pixels, Y axis should be rounded to. Should be used to override
	  the current frame dimensions to meet display and/or LCD host
	  controller requirements. The value must be power of 2.

config LV_USE_GPU_STM32_DMA2D_VEETHREE
	bool

config LV_GPU_DMA2D_CMSIS_INCLUDE_VEETHREE
	string
	help
	  Must be defined to include path of CMSIS header of target processor
	  e.g. "stm32f769xx.h" or "stm32f429xx.h"

rsource "Kconfig.memory"
rsource "Kconfig.input"
rsource "Kconfig.shell"


endif
```

## Kconfig.memory
```kconfig
# Copyright (c) 2018-2019 Jan Van Winkel <jan.van_winkel@dxplore.eu>
# Copyright (c) 2020 Teslabs Engineering S.L.
# SPDX-License-Identifier: Apache-2.0

menu "Memory manager settings"

config LV_Z_BITS_PER_PIXEL_VEETHREE
	int "Bits per pixel"
	default 32
	range 1 32
	depends on LV_Z_BUFFER_ALLOC_STATIC_VEETHREE
	help
	  Number of bits per pixel.

choice LV_Z_MEMORY_POOL_VEETHREE
	prompt "Memory pool"
	default LV_Z_MEM_POOL_SYS_HEAP_VEETHREE
	help
	  Memory pool to use for lvgl allocated objects

	config LV_Z_MEM_POOL_HEAP_LIB_C_VEETHREE
	  bool "C library Heap"
	  depends on !MINIMAL_LIBC || (COMMON_LIBC_MALLOC_ARENA_SIZE != 0)
	  help
		Use C library malloc and free to allocate objects on the C library heap

	config LV_Z_MEM_POOL_SYS_HEAP_VEETHREE
		bool "User space lvgl pool"
		select SYS_HEAP_INFO
		help
		  Use a dedicated memory pool from a private sys heap.

endchoice

config LV_Z_MEM_POOL_SIZE_VEETHREE
	int "Memory pool size"
	default 2048
	depends on LV_Z_MEM_POOL_SYS_HEAP_VEETHREE
	help
	  Size of the memory pool in bytes

config LV_Z_MEMORY_POOL_CUSTOM_SECTION_VEETHREE
	bool "Link memory pool to custom section"
	depends on LV_Z_MEM_POOL_SYS_HEAP_VEETHREE
	help
	  Place LVGL memory pool in custom section, with tag ".lvgl_heap".
	  This can be used by custom linker scripts to relocate the LVGL
	  memory pool to a custom location, such as tightly coupled or
	  external memory.

config LV_Z_VDB_SIZE_VEETHREE
	int "Rendering buffer size"
	default 100 if LV_Z_FULL_REFRESH_VEETHREE
	default 10
	range 1 100
	help
	  Size of the buffer used for rendering screen content as a percentage
	  of total display size.

config LV_Z_DOUBLE_VDB_VEETHREE
	bool "Use two rendering buffers"
	help
	  Use two buffers to render and flush data in parallel

config LV_Z_FULL_REFRESH_VEETHREE
	bool "Force full refresh mode"
	help
	  Force full refresh of display on update. When combined with
	  LV_Z_VDB_SIZE, this setting can improve performance for display
	  controllers that require a framebuffer to be present in system memory,
	  since the controller can render the LVGL framebuffer directly

config LV_Z_VDB_ALIGN_VEETHREE
	int "Rending buffer alignment"
	default 4
	depends on LV_Z_BUFFER_ALLOC_STATIC_VEETHREE
	help
	  Rendering buffer alignment. Depending on chosen color depth,
	  buffer may be accessed as a uint8_t *, uint16_t *, or uint32_t *,
	  so buffer must be aligned to prevent unaligned memory access

config LV_Z_VBD_CUSTOM_SECTION_VEETHREE
	bool "Link rendering buffers to custom section"
	depends on LV_Z_BUFFER_ALLOC_STATIC_VEETHREE
	help
	  Place LVGL rendering buffers in custom section, with tag ".lvgl_buf".
	  This can be used by custom linker scripts to relocate the LVGL
	  rendering buffers to a custom location, such as tightly coupled or
	  external memory.

choice LV_Z_RENDERING_BUFFER_ALLOCATION_VEETHREE
	prompt "Rendering Buffer Allocation"
	default LV_Z_BUFFER_ALLOC_STATIC_VEETHREE
	help
	  Type of allocation that should be used for allocating rendering buffers

config LV_Z_BUFFER_ALLOC_STATIC_VEETHREE
	bool "Static"
	help
	  Rendering buffers are statically allocated based on the following
	  configuration parameters:
	  * Horizontal screen resolution
	  * Vertical screen resolution
	  * Rendering buffer size
	  * Bytes per pixel

config LV_Z_BUFFER_ALLOC_DYNAMIC_VEETHREE
	bool "Dynamic"
	help
	  Rendering buffers are dynamically allocated based on the actual
	  display parameters

endchoice

endmenu
```

## Kconfig.shell
```kconfig
# Copyright (c) 2023 Fabian Blatz <fabianblatz@gmail.com>
# SPDX-License-Identifier: Apache-2.0

config LV_Z_SHELL_VEETHREE
	bool "LVGL Shell"
	depends on SHELL_VEETHREE
	help
	  Enable LVGL shell for testing.

if LV_Z_SHELL_VEETHREE

config LV_Z_MAX_MONKEY_COUNT_VEETHREE
	int "Maximum number of monkeys"
	default 4
	depends on LV_USE_MONKEY_VEETHREE
	help
	  Number of monkey instances that can exist in parallel

endif
```
